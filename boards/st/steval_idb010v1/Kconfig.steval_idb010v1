## boards/st/steval_idb010v1/Kconfig.steval_idb010v1
```kconfig
# Copyright (c) 2024 STMicroelectronics
# SPDX-License-Identifier: Apache-2.0

config BOARD_STEVAL_IDB010V1
	select SOC_STM32WB07XX
```

## boards/st/steval_idb010v1/steval_idb010v1_defconfig
```kconfig
# SPDX-License-Identifier: Apache-2.0

# Enable SMPS in regulation mode and select correct BOM
CONFIG_POWER_SUPPLY_SMPS_SUPPLIES_LDO=y
CONFIG_SMPS_BOM_3=y

# Enable clock
CONFIG_CLOCK_CONTROL=y

# Enable GPIO
CONFIG_GPIO=y

# Enable pin controller
CONFIG_PINCTRL=y

# Enable UART driver
CONFIG_SERIAL=y

# Enable console
CONFIG_CONSOLE=y
CONFIG_UART_CONSOLE=y
```

## boards/st/steval_idb012v2/Kconfig.steval_idb012v2
```kconfig
# Copyright (c) 2024 STMicroelectronics
# SPDX-License-Identifier: Apache-2.0

config BOARD_STEVAL_IDB012V2
	select SOC_STM32WB09XX
```

## drivers/interrupt_controller/Kconfig.stm32
```kconfig
# STM32 EXTI configuration

# Copyright (c) 2016 Open-RnD Sp. z o.o.
# SPDX-License-Identifier: Apache-2.0

if SOC_FAMILY_STM32

config EXTI_STM32
	bool "External Interrupt/Event Controller (EXTI) Driver for STM32 family of MCUs"
	default y
	depends on DT_HAS_ST_STM32_EXTI_ENABLED
	depends on !SOC_SERIES_STM32WB0
	help
	  Enable EXTI driver for STM32 line of MCUs

config WB0_GPIO_INTC_STM32
	bool "GPIO Interrupt Controller Driver for STM32WB0 series"
	default y
	depends on DT_HAS_ST_STM32_EXTI_ENABLED
	depends on SOC_SERIES_STM32WB0
	help
	  Enable GPIO interrupt controller driver for STM32WB0 series


endif # SOC_FAMILY_STM32
```

## dts/bindings/clock/st,stm32wb0-lsi-clock.yaml
```yaml
# Copyright (c) 2024 STMicroelectronics
# SPDX-License-Identifier: Apache-2.0

description: |
  STM32WB0 LSI Clock

  The STM32WB0 MCUs are equipped with a regular RC LSI clock with a frequency of 24~40kHz.
  The SoCs are also equipped with hardware to perform LSI frequency measurement, which
  allows to adapt all frequency-based calculations to a somewhat accurate value, ensuring
  that the software does not get too much out of sync with real-world time.

  This binding exposes several properties related to LSI frequency measurement options.

compatible: "st,stm32wb0-lsi-clock"

include: [fixed-clock.yaml]

properties:
  measurement-window-size:
    type: int
    required: true
    description: |
      Size of the measurement window for LSI calibration (in LSI periods)

      The measurement process involves waiting for a certain amount of LSI periods
      to occur, in order to determine precisely the LSI period, and thus frequency.

      This property controls how much LSI periods are required for each measure.
      Bigger window sizes increase accuracy of the measure, but increase the time
      needed to complete it. Since fLSI >= 24kHz, increasing the measurement window
      size makes each measure roughly 42µs slower in the worst case.

      This property must be between 16 and 256.

  runtime-measurement-interval:
    type: int
    description: |
      Interval at which runtime measurements should be performed, in milliseconds

      Since the LSI RC frequency is affected by temperature, which is not stable
      across time, it is highly recommended to perform measurements of the LSI
      frequency at regular intervals in order to obtain better accuracy.

      This property enables runtime LSI measurement if present. In this case,
      a background thread is created and performs LSI measurements, sleeping
      the amount of time specified in this property between each measure. This
      thread is also tasked with updating the control registers of peripherals
      affected by slow clock drift such as RTC or IWDG, in collaboration with
      the peripherals' drivers. Note that this increases the memory footprint
      of the clock control driver and can increase power consumption.

      If this property is not present, runtime LSI measurement is disabled, and
      the single measure performed at boot
```

## dts/bindings/flash_controller/st,stm32wb0-flash-controller.yaml
```yaml
description: STM32WB0 series flash controller

compatible: "st,stm32wb0-flash-controller"

include: flash-controller.yaml
```

## dts/bindings/sensor/st,stm32wb0-temp-cal.yaml
```yaml
# Copyright (c) 2024 STMicroelectronics
# SPDX-License-Identifier: Apache-2.0

description: |
    STM32 family TEMP node for production calibrated sensors like STM32WB0,
    which have a sensor value and a chuck temperature.

compatible: "st,stm32wb0-temp-cal"

include:
  - name: st,stm32-temp-cal-common.yaml
    property-blocklist:
      - ts-cal1-temp

properties:
  ts-tck-addr:
    type: int
    required: true
    description: |
      Address of chuck temperature ("TCK") parameter
```

## soc/st/stm32/stm32wb0x/Kconfig
```kconfig
# STMicroelectronics STM32W0 MCU series

# Copyright (c) 2024 STMicroelectronics
# SPDX-License-Identifier: Apache-2.0

config SOC_SERIES_STM32WB0
	select ARM
	select CPU_CORTEX_M0PLUS
	select CPU_CORTEX_M_HAS_VTOR
	select CPU_CORTEX_M_HAS_SYSTICK
	select CPU_HAS_ARM_MPU
	select HAS_STM32CUBE

	# WB0x has a ROM bootloader executed at reset,
	# which makes the following option required
	select INIT_ARCH_HW_AT_BOOT

if SOC_SERIES_STM32WB0

# SMPS configuration options (only enabled if SMPS is selected)
if !POWER_SUPPLY_LDO

# This is marked as `optional` to ensure the choice is made explicitly.
# Kconfig would otherwise automatically select one of the choices, something
# definitely unwanted. By marking `optional`, no symbol is selected instead,
# which we can detect to generate a compile-time error (done in `soc.c`).
choice SMPS_BOM_CHOICE
	bool "STM32WB0x SMPS L/C BOM selection"
	optional
	help
	  Selects the SMPS inductance/capacitance BOM implemented on
	  this board. Refer to RM0505 §5.5 "SMPS step down regulator"
	  for more details about the SMPS BOM.

config SMPS_BOM_1
	bool "1.5µH inductance, 2.2µF output capacitance"

config SMPS_BOM_2
	bool "2.2µH inductance, 4.7µF output capacitance"

config SMPS_BOM_3
	bool "10µH inductance, 4.7µF output capacitance"

endchoice

choice SMPS_DEEPSTOP_MODE
	bool "STM32WB0x SMPS mode in Deepstop state"
	default SMPS_DEEPSTOP_MODE_OPEN
	help
	  Selects SMPS mode when SoC is in Deepstop state.

config SMPS_DEEPSTOP_MODE_OPEN
	bool "SMPS disabled (floating output) in Deepstop"

config SMPS_DEEPSTOP_MODE_BYPASS
	bool "SMPS enabled (PRECHARGE/BYPASS mode) in Deepstop"

endchoice

choice SMPS_CURRENT_LIMIT_CHOICE
	bool "STM32WB0x SMPS current limit"
	depends on POWER_SUPPLY_SMPS_BYPASS_SUPPLIES_LDO
	default SMPS_CURRENT_LIMIT_20_MA
	help
	  Selects SMPS output current limit when operating in BYPASS mode.

config SMPS_CURRENT_LIMIT_2_5_MA
	bool "2.5mA"

config SMPS_CURRENT_LIMIT_5_MA
	bool "5mA"

config SMPS_CURRENT_LIMIT_10_MA
	bool "10mA"

config SMPS_CURRENT_LIMIT_20_MA
	bool "20mA"

endchoice

choice SMPS_OUTPUT_VOLTAGE_LEVEL_CHOICE
	prompt "STM32WB0x SMPS output voltage"
	depends on POWER_SUPPLY_SMPS_SUPPLIES_LDO
	default SMPS_OUTPUT_VOLTAGE_1_40V
	help
	  Selects SMPS output voltage when operating in ON mode.

	  WARNING: The SMPS output voltage "VSMPS" must be chosen to always
	  fullfill the following constraint:   (VBAT - VSMPS) >= 0.2V

config SMPS_OUTPUT_VOLTAGE_1_20V
	bool "1.20V"

config SMPS_OUTPUT_VOLTAGE_1_25V
	bool "1.25V"

config SMPS_OUTPUT_VOLTAGE_1_30V
	bool "1.30V"

config SMPS_OUTPUT_VOLTAGE_1_35V
	bool "1.35V"

config SMPS_OUTPUT_VOLTAGE_1_40V
	bool "1.40V"

config SMPS_OUTPUT_VOLTAGE_1_45V
	bool "1.45V"

config SMPS_OUTPUT_VOLTAGE_1_50V
	bool "1.50V"

config SMPS_OUTPUT_VOLTAGE_1_55V
	bool "1.55V"

config SMPS_OUTPUT_VOLTAGE_1_60V
	bool "1.60V"

config SMPS_OUTPUT_VOLTAGE_1_65V
	bool "1.65V"

config SMPS_OUTPUT_VOLTAGE_1_70V
	bool "1.70V"

config SMPS_OUTPUT_VOLTAGE_1_75V
	bool "1.75V"

config SMPS_OUTPUT_VOLTAGE_1_80V
	bool "1.80V"

config SMPS_OUTPUT_VOLTAGE_1_85V
	bool "1.85V"

config SMPS_OUTPUT_VOLTAGE_1_90V
	bool "1.90V"

config SMPS_OUTPUT_VOLTAGE_1_95V
	bool "1.95V"

endchoice

endif #if !POWER_SUPPLY_LDO

endif #if SOC_SERIES_STM32WB0
```

## soc/st/stm32/stm32wb0x/Kconfig.defconfig
```kconfig
# STMicroelectronics STM32WB0 MCU series

# Copyright (c) 2024 STMicroelectronics
# SPDX-License-Identifier: Apache-2.0

if SOC_SERIES_STM32WB0

# STM32WB0 MR_BLE radio supports only
# 128 simultaneous active connections
config BT_MAX_CONN
	range 1 128

rsource "Kconfig.defconfig.stm32wb0*"

endif # SOC_SERIES_STM32WB0
```

## soc/st/stm32/stm32wb0x/Kconfig.defconfig.stm32wb05xx
```kconfig
# STMicroelectronics STM32WB05 MCU

# Copyright (c) 2024 STMicroelectronics
# SPDX-License-Identifier: Apache-2.0

if SOC_STM32WB05XX

# TODO: this is the number of NVIC user IRQ; is that correct?
config NUM_IRQS
	default 32

endif # SOC_STM32WB05XX
```

## soc/st/stm32/stm32wb0x/Kconfig.defconfig.stm32wb06xx
```kconfig
# STMicroelectronics STM32WB06 MCU

# Copyright (c) 2024 STMicroelectronics
# SPDX-License-Identifier: Apache-2.0

if SOC_STM32WB06XX

# TODO: this is the number of NVIC user IRQ; is that correct?
config NUM_IRQS
	default 32

endif # SOC_STM32WB06XX
```

## soc/st/stm32/stm32wb0x/Kconfig.defconfig.stm32wb09xx
```kconfig
# STMicroelectronics STM32WB09 MCU

# Copyright (c) 2024 STMicroelectronics
# SPDX-License-Identifier: Apache-2.0

if SOC_STM32WB09XX

# TODO: this is the number of NVIC user IRQ; is that correct?
config NUM_IRQS
	default 32

endif # SOC_STM32WB09XX
```

## soc/st/stm32/stm32wb0x/Kconfig.soc
```kconfig
# STMicroelectronics STM32WB0 MCU series

# Copyright (c) 2024 STMicroelectronics
# SPDX-License-Identifier: Apache-2.0

# For compatibility with Cube, this symbol must
# not have a trailing "X" unlike other series
config SOC_SERIES_STM32WB0
	bool
	select SOC_FAMILY_STM32

config SOC_SERIES
	default "stm32wb0x" if SOC_SERIES_STM32WB0

config SOC_STM32WB05XX
	bool
	select SOC_SERIES_STM32WB0

config SOC_STM32WB06XX
	bool
	select SOC_SERIES_STM32WB0

config SOC_STM32WB07XX
	bool
	select SOC_SERIES_STM32WB0

config SOC_STM32WB09XX
	bool
	select SOC_SERIES_STM32WB0

# For compatibility with Cube, SoC names must
# not have trailing "xx" unlike other series
config SOC
	default "stm32wb05" if SOC_STM32WB05XX
	default "stm32wb06" if SOC_STM32WB06XX
	default "stm32wb07" if SOC_STM32WB07XX
	default "stm32wb09" if SOC_STM32WB09XX
```

/*
 * Copyright (c) 2024 STMicroelectronics
 *
 * SPDX-License-Identifier: Apache-2.0
 */

#include <st/wb0/stm32wb06_07.dtsi>

/ {
	soc {
		compatible = "st,stm32wb07", "st,stm32wb0", "simple-bus";
	};

	sram0: memory@20000000 {
		reg = <0x20000000 DT_SIZE_K(64)>;
	};
};
